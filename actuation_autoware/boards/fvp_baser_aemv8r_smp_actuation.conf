## actuation_autoware/boards/fvp_baser_aemv8r_smp_actuation.conf
```kconfig
# Copyright (c) 2024, Arm Limited.
# SPDX-License-Identifier: Apache-2.0

CONFIG_DDS_NETWORK_INTERFACE="ethernet"

CONFIG_MDIO=y

CONFIG_MDIO_INIT_PRIORITY=81
CONFIG_PHY_INIT_PRIORITY=82
# Use out of order priorities in order to work around a limitation in the
# SMSC91C111 driver in Zephyr.
CONFIG_ETH_INIT_PRIORITY=80
CONFIG_CHECK_INIT_PRIORITIES=n

CONFIG_ISR_STACK_SIZE=4096
CONFIG_PRIVILEGED_STACK_SIZE=4096

CONFIG_NET_DHCPV4=y
CONFIG_NET_DHCPV4_INITIAL_DELAY_MAX=2

# SMP
# TODO: We can try again with SMP enabled
CONFIG_SMP=n
```

## actuation_autoware/boards/native_sim_actuation.conf
```kconfig
# Copyright (c) 2023, Arm Limited.
# SPDX-License-Identifier: Apache-2.0

# DDS network interface
CONFIG_DDS_NETWORK_INTERFACE="zeth"

# IPv4 config
CONFIG_NET_CONFIG_SETTINGS=y
CONFIG_NET_CONFIG_NEED_IPV4=y
CONFIG_NET_CONFIG_MY_IPV4_ADDR="192.0.2.1"
CONFIG_NET_CONFIG_MY_IPV4_GW="192.0.2.2"
CONFIG_DNS_RESOLVER=y
CONFIG_DNS_RESOLVER_MAX_SERVERS=1
CONFIG_DNS_SERVER_IP_ADDRESSES=y
CONFIG_DNS_SERVER1="192.0.2.2"

# IPv4 peer
# CONFIG_NET_CONFIG_PEER_IPV4_ADDR="192.0.2.3"

# UART
CONFIG_UART_NATIVE_POSIX=y
CONFIG_NATIVE_UART_0_ON_OWN_PTY=y

# C
CONFIG_EXTERNAL_LIBC=y
CONFIG_NEWLIB_LIBC=n
CONFIG_NEWLIB_LIBC_NANO=n

# C++
CONFIG_EXTERNAL_LIBCPP=y
CONFIG_MINIMAL_LIBCPP=n
CONFIG_GLIBCXX_LIBCPP=n

# SMP
CONFIG_SMP=n
```

## actuation_autoware/west.yml
```yaml
# Copyright (c) 2024-2025, Arm Limited.
# SPDX-License-Identifier: Apache-2.0

# The west manifest file for the actuation Zephyr app.
#
# The per-installation west configuration file, .west/config, sets the
# path to the project containing this file in the [manifest] section's
# "path" variable.

---
manifest:
  defaults:
    remote: upstream

  remotes:
    - name: upstream
      url-base: https://github.com/zephyrproject-rtos

  #
  # Please add items below based on alphabetical order
  projects:
    - name: cmsis
      revision: 4b96cbb174678dcd3ca86e11e1f24bc5f8726da0
      path: modules/hal/cmsis
      groups:
        - hal
    - name: hal_nxp
      revision: d45b14c198d778658b7853b48378d2e132a6c4be
      path: modules/hal/hal_nxp
      groups:
        - hal
    - name: zephyr
      revision: 6aeb7a2b96c2b212a34f00c0ad3862ac19e826e8
      west-commands: scripts/west-commands.yml

  group-filter:
    - -ci

  self:
    path: actuation_autoware
```

## actuation_module/Kconfig
```kconfig
# Copyright (c) 2023, Arm Limited.
# SPDX-License-Identifier: Apache-2.0

# Override the range of MAX_PTHREAD_MUTEX_COUNT from zephyr/lib/posix/Kconfig
config MAX_PTHREAD_MUTEX_COUNT
	range 0 30000

# TODO: FINE TUNE THIS IF THING GOES WRONG
config THREAD_STACK_SIZE
	int "Stack size for threads"
	default 262144
	help
	  This config sets the stack size for threads.
	  It is used to limit the stack size for threads.

config LOG_LEVEL
	int "Log level for actuation module"
	default 2
	range 0 2
	help
	  This config sets the log level for actuation module.
	  0: No logs
	  1: Fatal, Error, Warning, Config
	  2: Debug
	  It is used to limit the rate of messages being published to the console.

config LOG_THROTTLE_RATE
	int "Throttle rate for rclcpp info"
	default 3
	help
	  This config sets the throttle rate in seconds for rclcpp-like messages.
	  It is used to limit the rate of messages being published to the console.

config DDS_NETWORK_INTERFACE
	string "Name of the network interface to be used by CycloneDDS"
	default ""
	help
	  When left undefined, CycloneDDS will automatically select an interface
	  based on its own criteria.

config DDS_DOMAIN_ID
	int "Domain ID for CycloneDDS"
	default 2
	help
	  This config sets the domain ID for CycloneDDS.

config DDS_LOG_LEVEL
	int "Log level for CycloneDDS"
	default 0
	range 0 2
	help
	  This config sets the log level for CycloneDDS.
	  0: No logs
	  1: Fatal, Error, Warning, Config
	  2: Debug
	  It is used to limit the rate of messages being published to the console.

config NET_IFACE1_ADDR
	string "Address for interface 1"
	default ""

config NET_IFACE1_GW
	string "Gateway for interface 1"
	default ""

config NET_IFACE1_NETMASK
	string "Netmask for interface 1"
	default ""

config NET_IFACE1_VLAN
	int "VLAN identifier for interface 1"
	default 0
	help
	  When different from 0, it sets the VLAN id for the interface 1.
	  Use 0 here if uncertain.

config NET_IFACE2_ADDR
	string "Address for interface 2"
	default ""

config NET_IFACE2_GW
	string "Gateway for interface 2"
	default ""

config NET_IFACE2_NETMASK
	string "Netmask for interface 2"
	default ""

config NET_IFACE2_VLAN
	int "VLAN identifier for interface 2"
	default 0
	help
	  When different from 0, it sets the VLAN id for the interface 2.
	  Use 0 here if uncertain.



source "Kconfig.zephyr"
```

## actuation_module/boards/fvp_baser_aemv8r_smp_actuation.conf
```kconfig
# Copyright (c) 2024-2025, Arm Limited.
# SPDX-License-Identifier: Apache-2.0

# DDS network interface
CONFIG_DDS_NETWORK_INTERFACE="ethernet"

# MDIO
CONFIG_MDIO=y

CONFIG_MDIO_INIT_PRIORITY=81
CONFIG_PHY_INIT_PRIORITY=82
# Use out of order priorities in order to work around a limitation in the
# SMSC91C111 driver in Zephyr.
CONFIG_ETH_INIT_PRIORITY=80
CONFIG_CHECK_INIT_PRIORITIES=n

# Increase network buffer sizes because we will be using VPN to connect to the virtual device
CONFIG_NET_PKT_RX_COUNT=8192
CONFIG_NET_PKT_TX_COUNT=8192
CONFIG_NET_BUF_TX_COUNT=8192
CONFIG_NET_BUF_RX_COUNT=8192

# SMP: Symmetric multiprocessing
# TODO: We can try SMP enabled.
CONFIG_SMP=n
```

## actuation_module/boards/s32z270dc2_rtu0_r52_actuation.conf
```kconfig
# Copyright (c) 2023, Arm Limited.
# SPDX-License-Identifier: Apache-2.0

# DDS network interface
CONFIG_DDS_NETWORK_INTERFACE="ethernet@74b00000"

# Network RX thread stack size
CONFIG_ETH_NXP_S32_RX_THREAD_STACK_SIZE=16384
```
